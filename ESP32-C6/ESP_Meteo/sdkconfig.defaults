## ESP32-C6/ESP_Meteo/sdkconfig.defaults
```kconfig
# Enable the built-in certificate bundle so esp_http_client HTTPS works
CONFIG_MBEDTLS_CERTIFICATE_BUNDLE=y
CONFIG_MBEDTLS_CERTIFICATE_BUNDLE_DEFAULT_FULL=y
```
